## config/west.yml
```yaml
manifest:
  remotes:
    - name: doctorcooper
      url-base: https://github.com/doctorcooper
  projects:
    - name: original-dao-zmk-config
      remote: doctorcooper
      revision: refactoring
      import: config/west.yml
  self:
    path: config
```
